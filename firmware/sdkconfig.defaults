## main/Kconfig.projbuild
```kconfig
menu "FloraCore OTA"

config FLORACORE_OTA_DEV_TEST
    bool "Enable developer-only BLE OTA test command"
    default n
    help
        Enables the developer command "ota test" through the existing
        FloraCore BLE terminal custom-command hook.

        This is for OTA bring-up only. Keep it disabled in production.
        The OTA manager itself still restricts downloads to the FloraOS
        firmware origin and validates TLS, project identity and version.

config FLORACORE_OTA_TEST_URL
    string "Developer OTA test image URL"
    depends on FLORACORE_OTA_DEV_TEST
    default "https://floraos.life/firmware/floracore/dev/FloraCore.bin"
    help
        HTTPS URL for the developer OTA test image. The OTA manager only
        accepts URLs beginning with:
        https://floraos.life/firmware/floracore/

config FLORACORE_OTA_TEST_EXPECTED_VERSION
    string "Expected developer OTA firmware version"
    depends on FLORACORE_OTA_DEV_TEST
    default "1.0.1"
    help
        Exact stable X.Y.Z version expected in the downloaded ESP-IDF
        application descriptor. The candidate must also be newer than the
        currently-running FloraCore firmware.

endmenu

menu "FloraCore Phase 20 hardware"

config FLORACORE_GROW_LIGHT_ENABLE
    bool "Enable authenticated cloud grow-light command support"
    default n
    help
        The physical grow light is fixed to GPIO1 and can be controlled locally
        by the RTC + BH1750 automation in main.c regardless of this setting.

        Enable this only when you also want Phase 20 to advertise and accept
        authenticated timed grow_light commands from FloraOS. When disabled,
        the actuator can still operate locally, but cloud grow_light command
        support remains 0.

endmenu
```
